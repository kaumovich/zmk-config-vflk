## boards/shields/charybdis/Kconfig.shield
```kconfig
config SHIELD_VFLK_LEFT
	def_bool $(shields_list_contains,vflk_left)

config SHIELD_VFLK_RIGHT
	def_bool $(shields_list_contains,vflk_right)
```

## boards/shields/vflk/Kconfig.defconfig
```kconfig
if SHIEL_VFLK

config ZMK_KEYBOARD_NAME
	default "vflk"

config ZMK_SPLIT_ROLE_CENTRAL
	default y

endif

if SHIELD_VFLK_LEFT || SHIELD_VFLK_RIGHT

config ZMK_SPLIT
	default y
	
endif
```
